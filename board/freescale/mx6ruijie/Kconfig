## board/freescale/mx6ruijie/Kconfig
```kconfig
if TARGET_MX6RUIJIE

config SYS_BOARD
	default "mx6ruijie"

config SYS_VENDOR
	default "freescale"

config SYS_SOC
	default "mx6"

config SYS_CONFIG_NAME
	default "mx6ruijie"

endif
```

## configs/mx6dlruijie_defconfig
```kconfig
CONFIG_ARM=y
CONFIG_ARCH_MX6=y
CONFIG_TARGET_MX6RUIJIE=y
CONFIG_SYS_EXTRA_OPTIONS="IMX_CONFIG=board/freescale/mx6ruijie/mx6dlruijie.cfg,MX6DL,SYS_USE_SPINOR"
CONFIG_CMD_GPIO=y
```

## configs/mx6qruijie_defconfig
```kconfig
CONFIG_ARM=y
CONFIG_ARCH_MX6=y
CONFIG_TARGET_MX6RUIJIE=y
CONFIG_SYS_EXTRA_OPTIONS="IMX_CONFIG=board/freescale/mx6ruijie/mx6q_4x_mt41j128.cfg,MX6Q,SYS_USE_SPINOR"
CONFIG_CMD_GPIO=y
```
